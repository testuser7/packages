## lang/rust/Config.in
```kconfig
menu "Configuration options (for developers)"

config RUST_SCCACHE
	bool "Use sccache"
	help
	  Shared compilation cache; see https://github.com/mozilla/sccache

config RUST_SCCACHE_DIR
	string "Set sccache directory" if RUST_SCCACHE
	default ""
	help
	  Store sccache in this directory.
	  If not set, uses './.sccache'

config RUST_USE_PREBUILT_BINARIES
	bool "Use prebuilt Rust binaries and target std when available"
	default y
	help
	  Use official prebuilt Rust host binaries and, when available, the
	  matching target standard library. Host libc and target triple are
	  auto-detected. Disable this to build the complete Rust toolchain
	  from source.

config RUST_BUILD_STD_ONLY_WITH_PREBUILT_BINARIES
	bool "Build only target std from source when using prebuilt Rust binaries"
	default n
	depends on RUST_USE_PREBUILT_BINARIES
	help
	  If no compatible prebuilt target standard library is available, keep
	  the prebuilt host compiler and build only the target standard library
	  from the matching, pinned Rust source component. Cargo dependencies
	  are downloaded through OpenWrt's hash-verifying download infrastructure
	  during preparation; the std build itself runs offline. If disabled,
	  the complete Rust toolchain is built from source instead.

endmenu
```
